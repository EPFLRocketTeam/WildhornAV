## distribution-package/layers/meta-st/meta-ert/conf/distro/openstlinux-ert.conf
```bitbake
#@NAME: openstlinux-ert
#@DESCRIPTION: OpenSTLinux customized for ERT (with GPLv3 software)

require conf/distro/include/st-default-distro-rules.inc
require conf/distro/include/st-default-distro-providers.inc
require conf/distro/include/openstlinux.inc

# =========================================================================
# Distribution definition for: st-openstlinux-ert-
# =========================================================================
DISTRO = "openstlinux-ert"
DISTRO_NAME = "ST OpenSTLinux - EPFL Rocket Team - (A Yocto Project Based Distro)"

# =========================================================================
# DISTRO features
# =========================================================================
#DISTRO_FEATURES_append = " opengl"
DISTRO_FEATURES_remove = " wifi bluetooth bluez5 gstreamer optee splashscreen wayland pam x11 kde tpm2 pulseaudio "

DISTRO_FEATURES_append = " gplv3 "
```

## distribution-package/layers/meta-st/meta-ert/conf/layer.conf
```bitbake
# We have a conf and classes directory, add to BBPATH
BBPATH .= ":${LAYERDIR}"

# We have recipes-* directories, add to BBFILES
BBFILES += "${LAYERDIR}/recipes-*/*/*.bb \
            ${LAYERDIR}/recipes-*/*/*.bbappend"

BBFILE_COLLECTIONS += "meta-ert"
BBFILE_PATTERN_meta-ert = "^${LAYERDIR}/"
BBFILE_PRIORITY_meta-ert = "7"

EULA_FILE_ST_stm32mpwildhornav = "${LAYERDIR}/conf/eula/${MACHINE}"
EULA_FILE_ST_MD5SUM_stm32mpwildhornav = "8b505090fb679839cefbcc784afe8ce9"

LAYERDEPENDS_meta-ert = "stm-st-stm32mp-mx"
LAYERSERIES_COMPAT_meta-ert = "dunfell"
```
